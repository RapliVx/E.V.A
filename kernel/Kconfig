## kernel/Kconfig
```kconfig
menu "Enhanced Visual-render Affinity (E.V.A)"

config SCHED_EVA
	bool "Enhanced Visual-render Affinity (E.V.A)"
	default y
	help
	  E.V.A optimizes game rendering threads by aggressively pinning them
	  to big/prime cores and applying optimal nice values, overriding the
	  CFS scheduler. Activated on-demand via sysctl.

endmenu
```
